## conf/distro/blackbone-distro.conf
```bitbake
LOCALCONF_VERSION = "1"

TARGET_VENDOR = "-element14"

DISTRO = "blackbone-distro"
DISTRO_NAME = "BeagleBone Black Distribution"
DISTRO_VERSION = "0.1"
DISTRO_VERSION[vardepsexclude] = "DATE"
DISTRO_CODENAME = "morty"
DISTRO_FEATURES = "argp ext3 vfat largefile usbhost zeroconf opengl wayland systemd pam nfs ${DISTRO_FEATURES_LIBC}"
DISTRO_EXTRA_RECOMMENDS += " kernel-modules"

SDK_TITLE = "${DISTRO}"
SDK_VENDOR = "-blackbone"
SDK_VERSION := "${@'${DISTRO_VERSION}'.replace('snapshot-${DATE}', 'snapshot')}"
SDK_VERSION[vardepsexclude] = "DATE"
SDK_NAME = "${DISTRO}-${TCLIBC}-${SDK_ARCH}-${IMAGE_BASENAME}-${TUNE_PKGARCH}"

TCLIBCAPPEND ?= ""

IMAGE_LINGUAS ?= "de-de"
IMAGE_OVERHEAD_FACTOR = "1"
IMAGE_ROOTFS_SIZE = "300000"


PREFERRED_PROVIDER_virtual/egl ?= "ti-sgx-ddk-um"
PREFERRED_PROVIDER_virtual/libgles1 ?= "ti-sgx-ddk-um"
PREFERRED_PROVIDER_virtual/libgles2 ?= "ti-sgx-ddk-um"

PREFERRED_PROVIDER_libgbm ?= "libgbm"
PREFERRED_PROVIDER_libgbm-dev ?= "libgbm"

PREFERRED_PROVIDER_virtual/libgl ?= "mesa-gl"
PREFERRED_PROVIDER_virtual/mesa ?= "mesa-gl"

OELAYOUT_ABI = "11"

require conf/distro/include/no-static-libs.inc
require conf/distro/include/yocto-uninative.inc

INHERIT += "uninative"
```

## conf/layer.conf
```bitbake
# We have a conf and classes directory, append to BBPATH
BBPATH .= ":${LAYERDIR}"

# We have a recipes directory, add to BBFILES
BBFILES += "${LAYERDIR}/recipes*/*/*.bb ${LAYERDIR}/recipes*/*/*.bbappend ${LAYERDIR}/images/*.bb"

BBFILE_COLLECTIONS += "meta-blackbone"
BBFILE_PATTERN_meta-blackbone := "^${LAYERDIR}/"
BBFILE_PRIORITY_meta-blackbone = "80"

LAYERDEPENDS_mb = "core yocto openembedded-layer"
```

## conf/machine/blackbone-board.conf
```bitbake
#@TYPE: Machine
#@NAME: Beaglebone 
#@DESCRIPTION: Machine configuration for the Beaglebone 

SOC_FAMILY = "ti335x"
TARGET_ARCH = "arm"
TARGET_PRODUCT = "${SOC_FAMILY}"
DEFAULT_TUNE ?= "cortexa8hf-neon"

require conf/machine/include/soc-family.inc
require conf/machine/include/tune-cortexa8.inc

PREFERRED_PROVIDER_virtual/kernel = "linux-beagleboard"
PREFERRED_PROVIDER_virtual/bootloader = "u-boot"
PREFERRED_PROVIDER_u-boot = "u-boot"
PREFERRED_VERSION_u-boot = "v2016.03%"

KERNEL_IMAGETYPE = "zImage"
KERNEL_DEVICETREE = "am335x-bone.dtb am335x-boneblack.dtb"
KERNEL_EXTRA_ARGS += "LOADADDR=${UBOOT_ENTRYPOINT}"

SPL_BINARY = "MLO"
UBOOT_SUFFIX = "img"
UBOOT_ENTRYPOINT = "0x80008000"
UBOOT_LOADADDRESS = "0x80008000"
UBOOT_MACHINE = "am335x_boneblack_config"

EXTRA_IMAGEDEPENDS += "u-boot"

SERIAL_CONSOLES = "115200;ttyS0 115200;ttyO0 115200;ttyGS0"

MACHINE_GUI_CLASS = "smallscreen"
MACHINE_FEATURES += "touchscreen ext3 serial usbhost vfat"

IMAGE_FSTYPES = "tar.xz"
IMAGE_BOOT_FILES ?= "u-boot.${UBOOT_SUFFIX} MLO"
```
